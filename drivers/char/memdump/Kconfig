## drivers/char/memdump/Kconfig
```kconfig
menu "Mem Dump Support"

config MEM_DUMP_CHAR
	tristate "char driver interface to dump phisical memory"
	default m
	depends on ARCH_MSM || ARCH_QSD
	help
	 Char driver interface for diag user space and diag-forwarding to ARM9 and back.
endmenu
```

## drivers/staging/splboot/Kconfig
```kconfig
menu "splboot module support"

config SPLBOOT
	tristate "splboot module support"
	default m
	help
	 For execute splload image.
endmenu
```
